#include "dz.h"
#include "SysTick.h"

u8 seg_tab[40] ={

	0xFF,0xE3,0xDD,0xDD,0xDD,0xDD,0xE3,0xFF,//0
	0xEF,0xE7,0xE3,0xE7,0xE7,0xE7,0xE7,0x81,//1
	
  // 0x7F,0xBF,0xDF,0xEF,0xF7,0xFB,0xFD,0xFE,
	
	// 0x7F,0x7F,0x7F,0x7F,0x7F,0x7F,0x7F,0x7F, // zuo lie
	// 0x00,0x7E,0x7E,0x7E,0x7E,0x7E,0x7E,0x00, // kou 
	// 0x00,0x00,0x00,0x00,0x00,0x00,0x00,0x00,
};

int a[8]={GPIO_Pin_0, GPIO_Pin_1, GPIO_Pin_2, GPIO_Pin_3, GPIO_Pin_4, GPIO_Pin_5, GPIO_Pin_6, GPIO_Pin_7};


// 数码管编码表
const uint8_t seg_tab1[16][8] ={ 
	{0xFF,0xE3,0xDD,0xDD,0xDD,0xDD,0xE3,0xFF}, // 0 
	{0xFF,0xFB,0xF9,0xFB,0xFB,0xFB,0xFB,0xE0}, // 1
	{0xFF,0xF3,0xED,0xFD,0xFD,0xFB,0xF7,0xE1}, // 2
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	{0xFF,0xE1,0xEF,0xEF,0xE1,0xEF,0xEF,0xEF}, // F
};

// 控制8个行 
const uint16_t rows[8]={GPIO_Pin_0,GPIO_Pin_1,GPIO_Pin_2,GPIO_Pin_3,GPIO_Pin_4,GPIO_Pin_5,GPIO_Pin_6,GPIO_Pin_7};

// 控制8个列 
const uint16_t cols[8]={GPIO_Pin_0,GPIO_Pin_1,GPIO_Pin_2,GPIO_Pin_3,GPIO_Pin_4,GPIO_Pin_5,GPIO_Pin_6,GPIO_Pin_7};


//点阵初始化
void LED_Init(void){
	GPIO_InitTypeDef GPIO_InitStructure;
	
	//单片机的 PD 口控制点阵模块的列
	RCC_APB2PeriphClockCmd(RCC_APB2Periph_GPIOD, ENABLE); // 使能PD口时钟
	GPIO_InitStructure.GPIO_Pin = GPIO_Pin_0|GPIO_Pin_1|GPIO_Pin_2|GPIO_Pin_3|GPIO_Pin_4|GPIO_Pin_5|GPIO_Pin_6|GPIO_Pin_7;
	GPIO_InitStructure.GPIO_Mode = GPIO_Mode_Out_PP;
	GPIO_InitStructure.GPIO_Speed = GPIO_Speed_50MHz;
	GPIO_Init(GPIOD, &GPIO_InitStructure);
	GPIO_SetBits(GPIOD, GPIO_Pin_0|GPIO_Pin_1|GPIO_Pin_2|GPIO_Pin_3|GPIO_Pin_4|GPIO_Pin_5|GPIO_Pin_6|GPIO_Pin_7);
	
	//单片机的 PE 口控制点阵模块的行
	RCC_APB2PeriphClockCmd(RCC_APB2Periph_GPIOE, ENABLE); // 使能PA口时钟
	GPIO_InitStructure.GPIO_Pin = GPIO_Pin_0|GPIO_Pin_1|GPIO_Pin_2|GPIO_Pin_3|GPIO_Pin_4|GPIO_Pin_5|GPIO_Pin_6|GPIO_Pin_7;
	GPIO_InitStructure.GPIO_Mode = GPIO_Mode_Out_PP;
	GPIO_Init(GPIOE, &GPIO_InitStructure);
	GPIO_SetBits(GPIOE, GPIO_Pin_0|GPIO_Pin_1|GPIO_Pin_2|GPIO_Pin_3|GPIO_Pin_4|GPIO_Pin_5|GPIO_Pin_6|GPIO_Pin_7);
	
}

void Delay(__IO u32 nCount){	 // 简单的延时函数
	for(; nCount != 0; nCount--);
}

// 数码管循环显示 
void led_display(void){ 
  for(int k = 0 ; k < 16 ; k++){           // 表示16个数字（0-F） 
    for(int i = 0 ; i < 1000 ; i++){       // 每个数字循环1000次，越大显示时间越长
      for(int v = 0 ; v < 8 ; v++){        // 控制8行 
        GPIO_Write(GPIOD, seg_tab1[k][v]); // 输出对应的列显示
        GPIO_ResetBits(GPIOE, rows[v]);    // 已选的行亮起 
        Delay(1000);                       // 视觉暂停，调节速度
        GPIO_SetBits(GPIOE, rows[v]);      // 行熄灭
      }
    }
  }
}



void led_display1(void){
	for(int k = 0 ; k < 16 ; k++){
		for(int i = 0 ; i < 100 ; i++){ 
			for(int v = 0 ; v < 8 ; v++){
				GPIO_Write(GPIOD, seg_tab[k]); // 列显示
				GPIO_ResetBits(GPIOE, a[v]);   // 行显示
        delay_ms(10);                  // 视觉暂停,
				GPIO_SetBits(GPIOE, a[v]);     // 行熄灭
				k++;
			}
			k = k - 8;
		}
		k = k + 7;
	}
}



